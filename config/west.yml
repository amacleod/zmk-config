## config/west.yml
```yaml
---
manifest:
  remotes:
    - name: zmkfirmware
      url-base: https://github.com/zmkfirmware
    - name: urob
      url-base: https://github.com/urob
    - name: dhruvinsh
      url-base: https://github.com/dhruvinsh
    - name: saixos
      url-base: https://github.com/nmunnich
    - name: sadekbaroudi
      url-base: https://github.com/sadekbaroudi
    - name: amacleod
      url-base: https://github.com/amacleod
  projects:
    - name: zmk
      remote: amacleod
      revision: rp2040zero
      import: app/west.yml
    - name: zmk-helpers
      remote: urob
      revision: main
    - name: zmk-auto-layer
      remote: urob
      revision: main
    - name: zmk-tri-state
      remote: dhruvinsh
      revision: main
    - name: zaphod-config
      remote: amacleod
      revision: main
    - name: weejock-zmk
      remote: amacleod
      revision: main
    - name: tern-zmk
      remote: amacleod
      revision: main
    - name: zmk-apiaster-module
      remote: saixos
      revision: main
    - name: zmk-fingerpunch-vik
      remote: sadekbaroudi
      revision: main
    - name: zmk-fingerpunch-controllers
      remote: sadekbaroudi
      revision: main
    - name: zmk-fingerpunch-keyboards
      remote: sadekbaroudi
      revision: main
  self:
    path: config
```
